## boards/arm/kleemann/Kconfig.board
```kconfig
# KLEEMANN board configuration

# Copyright (c) 2016 Linaro Limited.
# SPDX-License-Identifier: Apache-2.0

config BOARD_KLEEMANN
	bool "KLEEMANN V1 Development Board"
	depends on SOC_STM32F427XX
```

## boards/arm/kleemann/Kconfig.defconfig
```kconfig
# KLEEMANN board configuration

# Copyright (c) 2016 Linaro Limited.
# SPDX-License-Identifier: Apache-2.0

if BOARD_KLEEMANN

config BOARD
	default "kleemann"


endif # BOARD_KLEEMANN
```

## boards/arm/kleemann_v2/Kconfig.board
```kconfig
# KLEEMANN board configuration

# Copyright (c) 2016 Linaro Limited.
# SPDX-License-Identifier: Apache-2.0

config BOARD_KLEEMANN_V2
	bool "KLEEMANN V2 Development Board"
	depends on SOC_STM32F427XX
```

## boards/arm/kleemann_v2/Kconfig.defconfig
```kconfig
# KLEEMANN board configuration

# Copyright (c) 2016 Linaro Limited.
# SPDX-License-Identifier: Apache-2.0

if BOARD_KLEEMANN_V2

config BOARD
	default "kleemann_v2"


endif # BOARD_KLEEMANN_V2
```
